## commander/main/Kconfig.projbuild
```kconfig
# commander/Kconfig.projbuild
#
# Commander project configuration menu.
# All CONFIG_* symbols defined here are available in every source file
# as compile-time constants. Common components (health, output) use
# #ifndef guards so they compile correctly even when a symbol is absent.

menu "Commander Configuration"

    # ------------------------------------------------------------------ #
    # Identity                                                             #
    # ------------------------------------------------------------------ #

    config DEVICE_ID
        string "Device identifier (injected into all JSON output)"
        default "cmd_001"
        help
            Short unique string identifying this Commander unit.
            Appears as "device_id" in every JSON line from output_write().
            Keep it under 32 characters. No spaces or JSON-special characters.

    # ------------------------------------------------------------------ #
    # Buffer sizes (all static — zero heap allocation in these paths)      #
    # ------------------------------------------------------------------ #

    config OUTPUT_LINE_BUF_SIZE
        int "Output JSON line buffer size (bytes)"
        default 2048
        help
            Maximum length of one assembled output line, including the
            envelope fields ("source", "device_id", "uptime_ms", "msg")
            and the caller's body JSON. Increase if large scan results
            overflow. Buffer is stack-allocated inside output_write().

    # ---- Scan Parser (Stage C2) ----------------------------------------------
    config SCAN_PARSER_TASK_STACK_SIZE
        int "Parser task stack size (bytes)"
        default 4096
        help
            Stack size for the scan parser task. Increase if stack overflow is detected.
    config SCAN_PARSER_WATCHDOG_INTERVAL_MS
        int "Parser watchdog heartbeat max interval (ms)"
        default 10000
        help
            Maximum interval between watchdog heartbeats for the scan parser task.

    config SCAN_PARSER_DATA_BUF_SIZE
        int "Parser internal data[] buffer size (bytes)"
        default 800
        help
            Internal buffer size for the scan parser task. Increase if data overflow is detected.

    config CMD_BUF_SIZE
        int "Local command parser input buffer size (bytes)"
        default 128
        help
            Static buffer for the local serial command parser (cmd.c,
            Stage C5). Must be longer than the longest command string.
            No dynamic allocation; sized at compile time.

    config ACTION_CMD_BUF_SIZE
        int "Action command substitution buffer size (bytes)"
        default 512
        help
            Stack buffer used by the rule engine when resolving placeholder
            values (e.g. $device.bdaddr) in action command templates.
            Must be >= strlen(template) + strlen(largest_field_value) + 1.
            Overflow is detected and logged; the action is skipped, not truncated.

    config MAX_RULES
        int "Maximum number of rules in the rule engine"
        default 16
        range 1 64
        help
            Maximum number of rules the rule engine can hold at runtime.
            Rules are stored as individual NVS keys (rule_0 .. rule_N-1),
            so this also caps NVS usage.
            Evaluation time is O(rules * items_per_scan); keep this reasonable.

    # ------------------------------------------------------------------ #
    # Health monitor                                                       #
    # ------------------------------------------------------------------ #

    config HEALTH_TASK_STACK_SIZE
        int "Health monitor task stack size (bytes)"
        default 2560
        help
            Stack for the health monitor task. Needs enough room for
            ESP_LOGI format strings and esp_task_wdt calls.
            Monitor the actual watermark via the health log; reduce if > 50% unused.

    config HEALTH_INTERVAL_MS
        int "Health report interval (milliseconds)"
        default 30000
        help
            How often the health task logs heap/stack metrics.
            30 000 ms (30 s) is the default. Reduce during active debugging.

    config HEALTH_FRAG_WARN_THRESH
        int "Heap fragmentation warning threshold (percent, 0-100)"
        default 75
        help
            The health task logs a warning if fragmentation exceeds this value.
            Recalibrate upward after BT stack init (Stage C6) since Bluedroid
            fragments the heap by design on first init.

    # ------------------------------------------------------------------ #
    # Scanner input channel                                                #
    # ------------------------------------------------------------------ #

    config SCANNER_UART_NUM
        int "UART port number for scanner input (0, 1, or 2)"
        default 1
        help
            UART peripheral receiving JSON lines from the scanner.
            Default 1 keeps UART0 free for local command I/O and logging.
            Pin assignments are set in board_config.h.

    config SCANNER_UART_BAUD
        int "Scanner UART baud rate"
        default 115200
        help
            Must exactly match the scanner's configured output baud rate.
            Mismatch causes framing errors; the hardened UART driver in C1
            will detect and recover from these, but they should not occur.

    # ------------------------------------------------------------------ #
    # ESP-NOW (alternative to UART — Stage C1 option)                     #
    # ------------------------------------------------------------------ #

    config ESPNOW_ENABLED
        bool "Enable ESP-NOW input channel instead of UART"
        default n
        help
            When y, scanner_input uses ESP-NOW packets instead of UART.
            The 4-byte fragmentation header is always prepended even for
            payloads that fit in one packet, for forward compatibility.

    config ESPNOW_REASSEMBLY_BUF_SIZE
        int "ESP-NOW reassembly buffer size (bytes)"
        default 2048
        depends on ESPNOW_ENABLED
        help
            Buffer for reassembling fragmented ESP-NOW payloads.
            Must be >= the largest JSON line the scanner will produce
            (a full Wi-Fi scan with many APs can exceed 1500 bytes).

    config ESPNOW_PMK
        string "ESP-NOW pre-shared key (exactly 16 ASCII characters)"
        default "0000000000000000"
        depends on ESPNOW_ENABLED
        help
            Primary master key for ESP-NOW link encryption.
            MUST be changed from the default before production deployment.
            Exactly 16 ASCII characters.

    # ------------------------------------------------------------------ #
    # Logging                                                              #
    # ------------------------------------------------------------------ #

    config LOG_TO_UART1
        bool "Route ESP_LOGx diagnostic output to UART1"
        default n
        help
            When y, redirects all ESP_LOGx calls to UART1 via
            esp_log_set_vprintf(), keeping UART0 clean for the
            local command parser. Not yet implemented; reserved for
            Stage C5 log-separation work.

    config RULE_ENGINE_TASK_STACK_SIZE
        int "Rule engine task stack size (bytes)"
        default 4096
        help
            Must be >= 4096 in ESP-IDF v6.x (picolibc vfprintf stack use).

    config RULE_ENGINE_QUEUE_DEPTH
        int "Rule engine event queue depth"
        default 4
        help
            Number of scan_event_t items the queue can hold.

    config RULE_ENGINE_WDT_INTERVAL_MS
        int "Rule engine watchdog max heartbeat interval (ms)"
        default 10000
        help
            Maximum allowed time between rule engine watchdog feeds.

    config RULE_ENGINE_WDT_FEED_PERIOD_MS
        int "Rule engine queue read timeout / watchdog feed period (ms)"
        default 3000
        help
            Time the rule engine blocks waiting for events before feeding
            the watchdog. Must be less than RULE_ENGINE_WDT_INTERVAL_MS.
            Must be less than or equal to RULE_ENGINE_WDT_INTERVAL_MS / 10.

    config RULE_NAME_LEN
        int "Maximum rule name length (including null)"
        default 32
        help
            Maximum length of a rule name string, including the null terminator.
            Rule names are used in logs and must be unique. Keep them short.

    config RULE_CONDITION_VALUE_LEN
        int "Maximum condition value string length"
        default 64
        help
            Maximum length of a condition value string in the rule engine.

    config RULE_CMD_TMPL_LEN
        int "Maximum stored action command template length"
        default 256
        help
            Maximum length of the command template string stored in NVS for each rule.
            Must be <= ACTION_CMD_BUF_SIZE to ensure it can be fully resolved at runtime.

    config RULE_MAX_PLACEHOLDERS
        int "Maximum number of placeholders per command template"
        default 4
        help
            Maximum number of $placeholders allowed in an action command template.
            Placeholders are resolved at runtime with actual values from the scan event.
            This limit keeps the action command substitution logic manageable and bounded.

    config MAX_ACTION_MODULES
        int "Maximum number of registerable action modules"
        default 8
        help
            Number of action module slots in the static registry.
            Each slot holds one pointer (4 bytes). 8 is sufficient for
            dummy, bt_media, gpio, and wifi_deauth with spare slots.        
    config CMD_LINE_MAX
        int "Maximum command line length"
        default 256
        help
            Maximum length of a command line received by the local command parser.
            Must be <= CMD_BUF_SIZE and <= ACTION_CMD_BUF_SIZE to avoid truncation.
    config CMD_UART_RX_PIN
        int "Command UART RX pin"
        default 22
        help
            GPIO number for receiving local serial commands. Default 18 keeps it
            separate from the scanner UART RX pin (17) and avoids the bootstrapping
            issues of using UART0. Pin assignments are set in board_config.h.
    config CMD_UART_TX_PIN
        int "Command UART TX pin"
        default 19
        help
            GPIO number for transmitting local serial command responses. Default 17
            keeps it separate from the scanner UART TX pin (16) and avoids the
            bootstrapping issues of using UART0. Pin assignments are set in board_config.h.
    config CMD_UART_BAUD
        int "Command UART baud rate"
        default 115200
        help
            Baud rate for the local command parser UART. Must match the baud rate
            of the terminal or system sending commands to this UART.
    config CMD_RESP_BUF_SIZE
        int "Command parser response buffer size (bytes)"
        default 2048
        help
            Buffer size for assembling responses in the local command parser.
            Must be large enough for the longest expected response, including
            JSON formatting overhead. Stack-allocated in cmd.c.
    config BT_MEDIA_TASK_STACK_SIZE
    int "bt_media internal task stack (bytes)"
        default 6144
        help
            6144 is the minimum for Bluedroid + AVRCP call chains.
            Increase to 8192 if stack overflow occurs during heavy BT use.
    config BT_MEDIA_QUEUE_DEPTH
        int "bt_media command queue depth"
        default 4
        help
            Number of command_t items the bt_media action module's queue can hold.
    config BT_MEDIA_WDT_INTERVAL_MS
        int "bt_media watchdog max heartbeat interval (ms)"
        default 5000
        help
            Maximum interval (in milliseconds) between heartbeats from the bt_media action module.
endmenu
```

## scanner/main/Kconfig.projbuild
```kconfig
# scanner/main/Kconfig.projbuild

menu "Scanner Configuration"

    config SCANNER_DEVICE_ID
        string "Scanner device identifier (embedded in output JSON)"
        default "scan_001"
        help
            Short unique string identifying this scanner unit.
            Appears in the output_write envelope as device_id.

    config SCANNER_CMD_UART_RX_PIN
        int "Local console UART RX pin (UART2)"
        default 18
        help
            GPIO pin for the local command console receive line.

    config SCANNER_CMD_UART_TX_PIN
        int "Local console UART TX pin (UART2)"
        default 21
        help
            GPIO pin for the local command console transmit line.

    config SCANNER_CMD_UART_BAUD
        int "Local console UART baud rate"
        default 115200

    config SCANNER_DATA_UART_TX_PIN
        int "Data link UART TX pin (UART1, to Commander)"
        default 17
        help
            Connects to Commander UART1 RX (GPIO16 on Commander board).

    config SCANNER_DATA_UART_RX_PIN
        int "Data link UART RX pin (UART1, from Commander)"
        default 16
        help
            Connects to Commander UART1 TX (GPIO17 on Commander board).
            Used to receive scanner_cmd JSON objects from the Commander.

    config SCANNER_DATA_UART_BAUD
        int "Data link UART baud rate"
        default 115200

    config SCANNER_DUMMY_SCAN_INTERVAL_MS
        int "Dummy BLE scan event interval (ms)"
        default 5000
        help
            Period between synthetic scan_result JSON lines sent to the
            Commander while BLE scanning is active.

    config SCANNER_CONSOLE_LINE_MAX
        int "Maximum local console input line length (bytes)"
        default 256
        help
            Stack-allocated in scanner_console_task. Increase if very long
            commands are expected; decrease to save stack.
            
    config SCANNER_UART_NUM
        int "Scanner data UART number"
        default 1

    config SCANNER_UART_BAUD
        int "Scanner data UART baud rate"
        default 115200

endmenu
```
